## Documentation/devicetree/bindings/input/awinic,aw8697.yaml
```yaml
# SPDX-License-Identifier: (GPL-2.0-only OR BSD-2-Clause)
%YAML 1.2
---
$id: http://devicetree.org/schemas/input/awinic,aw8697.yaml#
$schema: http://devicetree.org/meta-schemas/core.yaml#

title: Awinic AW8697 LRA haptics controller

maintainers:
  - Luca Weiss <luca.weiss@fairphone.com>

description: |
  AW8697 drives a linear resonant actuator. Actuator-specific electrical
  parameters configure volatile registers, not a vendor waveform library.
  Board descriptions must supply parameters for their actual actuator.

properties:
  compatible:
    const: awinic,aw8697
  reg:
    maxItems: 1
  reset-gpios:
    maxItems: 1
    description: Reset pin, high when the controller is running.
  interrupts:
    maxItems: 1
  awinic,f0-preset:
    $ref: /schemas/types.yaml#/definitions/uint32
    minimum: 1000
    maximum: 3000
    description: Actuator resonance in tenths of a hertz.
  awinic,f0-coefficient:
    $ref: /schemas/types.yaml#/definitions/uint32
    minimum: 100
    maximum: 1000
    description: Chip frequency conversion coefficient.
  awinic,f0-calibration-percent:
    minimum: 0
    maximum: 10
    description: Allowed percentage deviation during resonance calibration.
  awinic,drive-level:
    $ref: /schemas/types.yaml#/definitions/uint32
    minimum: 1
    maximum: 127
    description: Actuator drive level for resonance detection.
  awinic,f0-detection-play-time:
    $ref: /schemas/types.yaml#/definitions/uint32
    minimum: 1
    maximum: 15
    description: Resonance detection preamble cycles.
  awinic,f0-detection-wait-time:
    $ref: /schemas/types.yaml#/definitions/uint32
    minimum: 0
    maximum: 15
    description: Resonance detection waiting cycles.
  awinic,f0-detection-repeat:
    $ref: /schemas/types.yaml#/definitions/uint32
    minimum: 1
    maximum: 4
    description: Number of resonance detection repetitions.
  awinic,f0-detection-trace:
    $ref: /schemas/types.yaml#/definitions/uint32
    minimum: 1
    maximum: 15
    description: Resonance detection trace cycles.
  awinic,bemf-upper-threshold:
    $ref: /schemas/types.yaml#/definitions/uint32
    minimum: 0
    maximum: 65535
    description: Upper back EMF threshold register value.
  awinic,bemf-lower-threshold:
    $ref: /schemas/types.yaml#/definitions/uint32
    minimum: 0
    maximum: 65535
    description: Lower back EMF threshold register value.
  awinic,boost-debug:
    $ref: /schemas/types.yaml#/definitions/uint8-array
    minItems: 3
    maxItems: 3
    description: Three actuator-specific boost configuration bytes.
  awinic,tset:
    $ref: /schemas/types.yaml#/definitions/uint8
    description: Actuator-specific TSET register value.
  awinic,r-spare:
    $ref: /schemas/types.yaml#/definitions/uint8
    description: Actuator-specific spare resistance register value.

required:
  - compatible
  - reg
  - reset-gpios
  - interrupts
  - awinic,f0-preset
  - awinic,f0-coefficient
  - awinic,f0-calibration-percent
  - awinic,drive-level
  - awinic,f0-detection-play-time
  - awinic,f0-detection-wait-time
  - awinic,f0-detection-repeat
  - awinic,f0-detection-trace
  - awinic,bemf-upper-threshold
  - awinic,bemf-lower-threshold
  - awinic,boost-debug
  - awinic,tset
  - awinic,r-spare

additionalProperties: false
```

## Documentation/devicetree/bindings/media/i2c/sony,imx471.yaml
```yaml
# SPDX-License-Identifier: (GPL-2.0-only OR BSD-2-Clause)
%YAML 1.2
---
$id: http://devicetree.org/schemas/media/i2c/sony,imx471.yaml#
$schema: http://devicetree.org/meta-schemas/core.yaml#

title: Sony IMX471 CMOS image sensor

maintainers:
  - Mikkel Inumineq <6770514+inumineq@users.noreply.github.com>

description:
  The IMX471 is a Sony CMOS image sensor controlled over I2C. Image data
  is transmitted over a four-lane MIPI CSI-2 D-PHY interface.

allOf:
  - $ref: /schemas/media/video-interface-devices.yaml#

properties:
  compatible:
    const: sony,imx471

  reg:
    maxItems: 1

  clocks:
    description: External input clock (19.2 MHz)
    maxItems: 1

  avdd-supply:
    description: Analog power supply

  dvdd-supply:
    description: Digital core power supply

  dovdd-supply:
    description: Digital I/O power supply

  reset-gpios:
    description: Active-low sensor reset
    maxItems: 1

  port:
    $ref: /schemas/graph.yaml#/$defs/port-base
    unevaluatedProperties: false

    properties:
      endpoint:
        $ref: /schemas/media/video-interfaces.yaml#
        unevaluatedProperties: false

        properties:
          data-lanes:
            items:
              - const: 1
              - const: 2
              - const: 3
              - const: 4

        required:
          - data-lanes
          - link-frequencies

    required:
      - endpoint

required:
  - compatible
  - reg
  - clocks
  - avdd-supply
  - dvdd-supply
  - dovdd-supply
  - port

unevaluatedProperties: false

examples:
  - |
    #include <dt-bindings/gpio/gpio.h>

    i2c {
        #address-cells = <1>;
        #size-cells = <0>;

        camera@10 {
            compatible = "sony,imx471";
            reg = <0x10>;
            clocks = <&cam_clk>;
            avdd-supply = <&cam_avdd>;
            dvdd-supply = <&cam_dvdd>;
            dovdd-supply = <&cam_dovdd>;
            reset-gpios = <&gpio 78 GPIO_ACTIVE_LOW>;

            port {
                endpoint {
                    remote-endpoint = <&csi_in>;
                    data-lanes = <1 2 3 4>;
                    link-frequencies = /bits/ 64 <200000000>;
                };
            };
        };
    };
...
```

## Documentation/devicetree/bindings/power/supply/qcom,pm8150b-charger.yaml
```yaml
# SPDX-License-Identifier: GPL-2.0 OR BSD-2-Clause
%YAML 1.2
---
$id: http://devicetree.org/schemas/power/supply/qcom,pm8150b-charger.yaml#
$schema: http://devicetree.org/meta-schemas/core.yaml#

title: Qualcomm PM8150B Switch-Mode Battery Charger "5"

maintainers:
  - Teguh Sobirin <teguh@sobir.in>

properties:
  compatible:
    const: qcom,pm8150b-charger

  reg:
    maxItems: 1

  interrupts:
    minItems: 4
    maxItems: 5

  interrupt-names:
    minItems: 4
    items:
      - const: usbin-plugin
      - const: bat-ov
      - const: wdog-bark
      - const: usbin-icl-change
      - const: usbin-src-change

  io-channels:
    items:
      - description: USB in current in uV of sense voltage
      - description: USB in voltage divided by 16

  io-channel-names:
    items:
      - const: usb_in_i_uv
      - const: usb_in_v_div_16

  monitored-battery: true

  power-supplies: true

  qcom,fuel-gauge:
    $ref: /schemas/types.yaml#/definitions/phandle
    description:
      Fuel gauge at the battery cell. When present, the driver charges by
      its readings with temperature-dependent limits and lets it decide
      when the battery is full.

required:
  - compatible
  - reg
  - interrupts
  - interrupt-names
  - io-channels
  - io-channel-names
  - monitored-battery

allOf:
  - $ref: power-supply.yaml#

additionalProperties: false

examples:
  - |
    #include <dt-bindings/interrupt-controller/irq.h>

    pmic {
      #address-cells = <1>;
      #size-cells = <0>;

      charger@1000 {
        compatible = "qcom,pm8150b-charger";
        reg = <0x1000>;

        interrupts = <0x2 0x13 0x4 IRQ_TYPE_EDGE_BOTH>,
                     <0x2 0x12 0x2 IRQ_TYPE_EDGE_BOTH>,
                     <0x2 0x16 0x1 IRQ_TYPE_EDGE_RISING>,
                     <0x2 0x13 0x7 IRQ_TYPE_EDGE_RISING>,
                     <0x2 0x13 0x6 IRQ_TYPE_EDGE_RISING>;
        interrupt-names = "usbin-plugin", "bat-ov", "wdog-bark",
                          "usbin-icl-change", "usbin-src-change";

        io-channels = <&pm8150b_adc 7>, <&pm8150b_adc 8>;
        io-channel-names = "usb_in_i_uv", "usb_in_v_div_16";

        monitored-battery = <&battery>;
        qcom,fuel-gauge = <&fuel_gauge>;
      };
    };
```

## Documentation/devicetree/bindings/sound/nxp,tfa987x.yaml
```yaml
# SPDX-License-Identifier: (GPL-2.0-only OR BSD-2-Clause)
%YAML 1.2
---
$id: http://devicetree.org/schemas/sound/nxp,tfa987x.yaml#
$schema: http://devicetree.org/meta-schemas/core.yaml#

title: NXP/Goodix TFA9872/9873/9874 Audio Amplifiers

maintainers:
  - Mikkel Inumineq Jørgensen <6770514+inumineq@users.noreply.github.com>

description:
  Single-channel class-D audio amplifiers with an integrated boost converter,
  controlled over I2C and fed by a TDM or I2S stream. They are programmed
  directly over I2C; no firmware container is loaded.

allOf:
  - $ref: dai-common.yaml#

properties:
  compatible:
    enum:
      - nxp,tfa9872
      - nxp,tfa9873
      - nxp,tfa9874

  reg:
    maxItems: 1

  '#sound-dai-cells':
    const: 0

  reset-gpios:
    maxItems: 1
    description:
      Active-high reset line. The amplifier is held in reset while the line
      is asserted and must be released before the first register access.

  vddd-supply:
    description: regulator phandle for the VDDD power supply.

  sound-name-prefix: true

  sound-channel:
    $ref: /schemas/types.yaml#/definitions/uint32
    enum: [0, 1]
    description:
      TDM slot the amplifier plays from, 0 for the left and 1 for the right
      channel of the attached stream.

required:
  - compatible
  - reg
  - '#sound-dai-cells'
  - vddd-supply

additionalProperties: false

examples:
  - |
    #include <dt-bindings/gpio/gpio.h>

    i2c {
      #address-cells = <1>;
      #size-cells = <0>;

      audio-codec@34 {
        compatible = "nxp,tfa9874";
        reg = <0x34>;
        #sound-dai-cells = <0>;
        reset-gpios = <&tlmm 91 GPIO_ACTIVE_HIGH>;
        vddd-supply = <&vreg_s4a_1p8>;
        sound-channel = <0>;
        sound-name-prefix = "Top Speaker";
      };
    };
```
